## boards/shields/corneCirque/Kconfig.defconfig
```kconfig
if SHIELD_CORNECIRQUE_RIGHT

# Name must be less than 16 characters long!
config ZMK_KEYBOARD_NAME
    default "Corne Cirque"

config ZMK_SPLIT_ROLE_CENTRAL
    default y

config ZMK_POINTNG
    default y

config I2C
    default y

endif

if SHIELD_CORNECIRQUE_LEFT || SHIELD_CORNECIRQUE_RIGHT

config ZMK_SPLIT
    default y

endif
```

## boards/shields/nice_view_anim_only/Kconfig.defconfig
```kconfig
# Copyright (c) 2023 The ZMK Contributors
# SPDX-License-Identifier: MIT

if SHIELD_NICE_VIEW_ANIM_ONLY

config CUSTOM_ANIMATION_SPEED
    int "Total duration in milliseconds for animation to take"
    default 9600

config LV_Z_VDB_SIZE
    default 100

config LV_DPI_DEF
    default 161

config LV_Z_BITS_PER_PIXEL
    default 1

choice LV_COLOR_DEPTH
    default LV_COLOR_DEPTH_1
endchoice

choice ZMK_DISPLAY_WORK_QUEUE
    default ZMK_DISPLAY_WORK_QUEUE_DEDICATED
endchoice

choice ZMK_DISPLAY_STATUS_SCREEN
    default ZMK_DISPLAY_STATUS_SCREEN_CUSTOM
endchoice

config LV_Z_MEM_POOL_SIZE
    default 4096 if ZMK_DISPLAY_STATUS_SCREEN_CUSTOM

config ZMK_DISPLAY_STATUS_SCREEN_CUSTOM
    imply NICE_VIEW_WIDGET_STATUS

config NICE_VIEW_WIDGET_STATUS
    bool "Custom nice!view status widget"
    select LV_USE_IMG
    select LV_USE_ANIMIMG 
    select LV_USE_ANIMATION

config NICE_VIEW_WIDGET_INVERTED
    bool "Invert custom status widget colors"

config ZMK_DISPLAY_STATUS_SCREEN_BUILT_IN
    select LV_FONT_MONTSERRAT_26

endif # SHIELD_NICE_VIEW_ANIM_ONLY
```

## config/west.yml
```yaml
manifest:
  defaults:
    revision: v0.3
  remotes:
    - name: zmkfirmware
      url-base: https://github.com/zmkfirmware
    - name: gpeye
      url-base: https://github.com/GPeye
    # Additional modules containing boards/shields/custom code can be listed here as well
    # See https://docs.zephyrproject.org/3.2.0/develop/west/manifest.html#projects
  projects:
    - name: zmk
      remote: zmkfirmware
      import: app/west.yml
    - name: urchin-peripheral-animation
      remote: gpeye
      revision: main
  self:
    path: config
```
